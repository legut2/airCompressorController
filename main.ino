#include <Wire.h>
#include <LiquidCrystal_I2C.h>

#define ON   0
#define OFF  1
#define OPEN 0
#define CLOSED 1
#define HEAD_VALVE 46
#define DRAIN_VALVE 48
#define MAINT_COMPR 50
#define PRIME_COMPR 52
#define ERROR_LIGHT 44

//state of compressors and valves
boolean headValveOpen = false;
boolean drainValveOpen = false;
boolean maintComprOn = false;
boolean primComprOn = false;

//flags for each state except for power-up init. because setup will be that state
#define POWER_UP_STATE 0
String powerUp = " POWER-UP INIT";
#define NORM_IDLE_STATE 1
String normIdle = " NORMAL IDLE  ";
#define MAINT_COMPR_STATE 2
String maintCompr = " MAINT. COMPR.";
#define PRIME_COMPR_STATE 3
String primaryCompr = " PRIM.  COMPR.";
#define TIME_ERROR_STATE 4
String timeError = " TIME ERROR   ";
#define OPEN_DRAIN_STATE 5
String openDrain = " OPEN DRAIN   ";

//flag for whether error light should be on
boolean errorLightOn = false;


// Set the LCD address to 0x27 for a 20 chars and 4 line display
LiquidCrystal_I2C lcd(0x27, 20, 4);

int current_state = -1;
unsigned long timerBegin = 0;
unsigned long start = 0;
int day = 0; // 0 is sunday - 6 is saturday
int hour = 0; // 0 is 12am - 23 is 11pm

int timerHours = 0;
int timerMinutes = 0;

//THESE VALUES PROBABLY NEED TO BE CHANGED TO REFLECT WIRING
#define ERROR_BUTTON 24
#define SUBTRACT_BUTTON 26
#define ADD_BUTTON 28
#define SELECT_BUTTON 30

void buttons_init() {
  pinMode(ERROR_BUTTON, INPUT);
  pinMode(SUBTRACT_BUTTON, INPUT);
  pinMode(ADD_BUTTON, INPUT);
  pinMode(SELECT_BUTTON, INPUT);
}
boolean checkButtonPress(int buttonPin) {
  return (digitalRead(buttonPin) == HIGH);
}
//Setup is the the Power-Up Initialization State
void setup() {
  current_state = 0;
  relay_init();
  buttons_init();
  Serial.begin(9600);
  Wire.begin();
  lcd.init();
  lcd.backlight();
  lcd.print(generateLCDString(current_state));
  delay(3000);
  current_state = 1;
}

boolean selectDay = true;

void updateClock() {
  unsigned long dur = millis() - start;
  //Handle buttons for time changing
  if (checkButtonPress(SELECT_BUTTON)) {
    if (selectDay == true) {
      selectDay = false;
    } 
    else {
      selectDay = true;
    }
  }
  if (checkButtonPress(ADD_BUTTON)) {
    if (selectDay) {
      day++;
      if (day > 6) {
        day = 0;
      }
    }
    if (selectDay == false) {
      hour++;
      if (hour > 23) {
        hour = 0;
      }
    }
  }
  if (checkButtonPress(SUBTRACT_BUTTON)) {
    if (selectDay) {
      day--;
      if (day < 0) {
        day = 6;
      }
    }
    if (selectDay == false) {
      hour--;
      if (hour < 0) {
        hour = 23;
      }
    }
  }
  if (dur > 3600000) {
    hour++;
    if (hour > 23) {
      day++;
      hour = 0;
      if (day > 6) {
        day = 0;
      }
    }
    start = millis();
  }
}
// This makes the string that gets sent to the lcd
// it always outputs a 80 character string (because 20x4 lcd)
// if it is not 80 characters then the lcd will start to look 
// like sliding letters across the lcd
// first 20 chars get printed onto the first 20 spots on lcd
// 2nd 20 chars goes to 3rd set of 20 spots on lcd (dont know why its that order)
// 3rd set of 20 chars goes to 2nd line
// 4th set of 20 chars goes to last line onto screen
String generateLCDString(int currState) {
  String r = "STATE:";
  
  if (current_state == POWER_UP_STATE) {
    r += powerUp;
  }
  else if (current_state == NORM_IDLE_STATE) {
    r += normIdle;
  }
  else if (current_state == MAINT_COMPR_STATE) {
    r += maintCompr;
  }
  else if (current_state == PRIME_COMPR_STATE) {
    r += primaryCompr;
  }
  else if (current_state == TIME_ERROR_STATE) {
    r += timeError;
  }
  else if (current_state == OPEN_DRAIN_STATE) {
    r += openDrain;
  } 
  r += "H:";
  r += formatPSI(getHeadPressure());
  r += " PSI ";
  r += "M:";
  r += formatPSI(getMainPressure());
  r += " PSI ";
  //Clock "DAY:X H:XX   T-XX:XX"
  r += "DAY:";
  r += getDay();
  r += " H:";
  r += formatTwoDigitTime(getHour()); // needs to be formatted
  r += "   T-";
  r += formatTwoDigitTime(getHoursTimer());         // needs to be formatted
  r += ":";          //
  r += formatTwoDigitTime(getMinutesTimer());           // needs to be formatted
  r += "P";
  if (primComprOn) {
    r += " ON";
  }
  else {
    r += "OFF";
  }
  r += " M";
  if (maintComprOn) {
    r += " ON";
  }
  else {
    r += "OFF";
  }
  r += " H-";
  if (headValveOpen) {
    r += "OP";
  }
  else {
    r += "CL";
  }
  r += " D-";
  if (drainValveOpen) {
    r += "OP";
  }
  else {
    r += "CL ";
  }
  return r;
}
//This helps keep same number of characters printed when generating the lcd string
String formatTwoDigitTime(int i) {
  String r;
  if (i < 10) {
    r += "0";
    r += i;
  }
  else {
    r += i;
  }
  return r;
}
//This helps keep same number of characters printed when generating the lcd string
String formatPSI(float pressure) {
  String r;
  if (pressure <= 0) {
    return "000";
  }
  else if (pressure > 0 && pressure < 100) {
    r = "00";
    r += (int)(pressure);
  }
  else {
    r = (int)(pressure);
  }
  return r;
}
void relay_init()//initialize the relay
{
  //set all the relays OUTPUT
  pinMode(HEAD_VALVE, OUTPUT);
  pinMode(DRAIN_VALVE, OUTPUT);
  pinMode(MAINT_COMPR, OUTPUT);
  pinMode(PRIME_COMPR, OUTPUT);
  pinMode(ERROR_LIGHT, OUTPUT);
  relay_SetStatus(PRIME_COMPR, OFF);
  relay_SetStatus(MAINT_COMPR, OFF);
  relay_SetStatus(ERROR_LIGHT, OFF);
  relay_SetStatus(HEAD_VALVE, CLOSED);
  relay_SetStatus(DRAIN_VALVE, CLOSED);
}

//this sets a relay to either OFF (CLOSED), or ON (OPEN)
//those values for the status are defined at the top of this file
void relay_SetStatus(int relayPin, unsigned char status) {
  digitalWrite(relayPin, status);
}

// get head pressure (PSI) averaged over 8 readings
float getHeadPressure() {
  float p0 = 0;
  for (int i = 0; i < 8; i++) {
    p0 = p0 + readPSIRAW(A0);
  }
  p0 = p0 / 8;

  return ((((p0 * 5) / 1024) - 0.50) * 50);
}

// get main pressure (PSI) averaged over 8 readings and average those two averages unless there is a precent diff of greater than 20%
float getMainPressure() {
  float p2 = 0;
  float p1 = 0;
  for (int i = 0; i < 8; i++) {
    p1 = p1 + readPSIRAW(A1);
    p2 = p2 + readPSIRAW(A2);
  }
  p1 = p1 / 8; //Averaged values now
  p2 = p2 / 8;

  //See if they are different by more than 20%, if so return lower amount as a psi and not raw value
  float percDiff = getPercentDifference(p1, p2);
  //Serial.println(percDiff);
  if (percDiff >= 20) {
    if (p1 > p2) {
      return ((((p2 * 5) / 1024) - 0.50) * 50); // Convert to PSI
    }
    else {
      return ((((p1 * 5) / 1024) - 0.50) * 50); // Convert to PSI
    }
  }
  return ((((((p1 + p2) / 2) * 5) / 1024) - 0.50) * 50); // Convert to PSI
}
//calculates percent difference and not percent error, percent error is used for values that have a known standard
//percent difference is used for values that are both experimental or unknown if real value
float getPercentDifference(float p2, float p1) {
  return (abs(p1 - p2) / (0.5 * (p1 + p2))) * 100; // % diff = [|E1-E2|/(0.5(E1+E2))]*100
}

// get raw output of pressure sensor
float readPSIRAW(int analogPIN) {
  return analogRead(analogPIN);
}

// get psi output of pressure sensor as float
float readPSI(int analogPIN) {
  int sensorVal = analogRead(analogPIN);
  float voltage = (sensorVal * 5.0) / 1024.0;
  float psi = (voltage - 0.50) * 50;
  return psi;
}

// this exhausts head pressure by opening head valve until PSI is below 5 PSI
void exhaustHeadPressureBelowFivePSI() {
  while (getHeadPressure() > 5) {
    relay_SetStatus(HEAD_VALVE, OPEN);
    headValveOpen = true;
    delay(5000); // lcd will not update as frequently with 5 second delay
    lcd.print(generateLCDString(current_state));
  }
  relay_SetStatus(HEAD_VALVE, CLOSED);
  headValveOpen = false;
}

//resets timer so timer can continue
void resetTimer() {
  timerBegin = millis();
}

//this updates the timer variables
void updateTimer() {
  unsigned long elapsedMilliseconds = millis() - timerBegin;
  unsigned long h = elapsedMilliseconds / 3600000;
  unsigned long m = (elapsedMilliseconds % 3600000) / 60000;
  h = h % 24;
  timerHours = h;
  timerMinutes = m;
}
//updates clock prior to getting value from variable - ensures that value is always updated
int getHour() {
  updateClock();
  return hour;
}
//updates clock prior to getting value from variable - ensures that value is always updated
int getDay() {
  updateClock();
  return day;
}
//updates timer prior to getting value from variable - ensures that value is always updated
int getHoursTimer() {
  updateTimer();
  return timerHours;
}
//updates timer prior to getting value from variable - ensures that value is always updated
int getMinutesTimer() {
  updateTimer();
  return timerMinutes;
}
//main loop
void loop() {
  stateMachine();
  lcd.print(generateLCDString(current_state));
  updateClock();
  delay(350);
}
//basic warning that is 80 chars long and can be changed to whatever to take up whole screen
//first 20 chars - 1st line, 2nd 20 chars - 3rd line, 3rd set of 20 chars - 2nd line, 4th set - line 4 <---- not sure why it does it in this order but it does
void displayWarning() {
  lcd.print("WARNING130PSIWARNINGwarning130PSIwarningWARNING130PSIWARNINGwarning130PSIwarning");
  delay(2000);
}
//toggle function of light
void toggleErrorLight() {
  if (errorLightOn) {
    errorLightOn = false;
    relay_SetStatus(ERROR_LIGHT, OFF);
  }
  else {
    errorLightOn = true;
    relay_SetStatus(ERROR_LIGHT, ON);
  }
}
//turns light on
void turnOnErrorLight() {
  errorLightOn = true;
  relay_SetStatus(ERROR_LIGHT, ON);
}
//turns l
void turnOffErrorLight() {
  errorLightOn = false;
  relay_SetStatus(ERROR_LIGHT, OFF);
}
boolean drained = false;
boolean maintInit = false;
boolean errorInit = false;
boolean primeInit = false;
float tank = 0;
void stateMachine() {
  Serial.println(current_state);
  if(current_state == NORM_IDLE_STATE) {
    exhaustHeadPressureBelowFivePSI();
    relay_SetStatus(PRIME_COMPR, OFF);
    relay_SetStatus(MAINT_COMPR, OFF);
    maintComprOn = false;
    primComprOn = false;
    exhaustHeadPressureBelowFivePSI();
    tank = getMainPressure();
    if (tank < 95) {
      current_state = PRIME_COMPR_STATE;
    }
    else if (tank < 100) {
      current_state = MAINT_COMPR_STATE;
    }
    else if (tank > 130) {
      relay_SetStatus(PRIME_COMPR, OFF);
      relay_SetStatus(MAINT_COMPR, OFF);
      maintComprOn = false;
      primComprOn = false;  
      displayWarning();
      turnOnErrorLight();
    }
    if (getDay() == 0 && getHour() == 2 && drained == false) {
      drained = true;
      current_state = OPEN_DRAIN_STATE; 
  
    }
    // the following if statement is to prevent it from draining constantly for an hour on the first day
    if (getDay() == 0 && getHour() == 3) {
      drained = false;
    }
  }
  else if(current_state == MAINT_COMPR_STATE) {
    if (maintInit == false) {
      relay_SetStatus(PRIME_COMPR, OFF);
      relay_SetStatus(MAINT_COMPR, OFF);
      maintComprOn = false;
      primComprOn = false;
      exhaustHeadPressureBelowFivePSI();
      relay_SetStatus(MAINT_COMPR, ON);
      maintComprOn = true;
      resetTimer();
      maintInit = true;
    }
    tank = getMainPressure();
    if (tank < 95) {
      maintInit = false;
      current_state = PRIME_COMPR_STATE;
    }
    else if (tank > 120) {
      relay_SetStatus(PRIME_COMPR, OFF);
      relay_SetStatus(MAINT_COMPR, OFF);
      maintComprOn = false;
      primComprOn = false;
      resetTimer();                                  //reset error counter? means reset timer?
      turnOffErrorLight();
      maintInit = false;
      current_state = NORM_IDLE_STATE;
    }
    else if (getMinutesTimer() > 14) {
      maintInit = false;
      current_state = TIME_ERROR_STATE;
    }
  }
  else if (current_state == PRIME_COMPR_STATE) {
    if (primeInit == false) {
      relay_SetStatus(PRIME_COMPR, OFF);
      relay_SetStatus(MAINT_COMPR, OFF);
      maintComprOn = false;
      primComprOn = false;
      exhaustHeadPressureBelowFivePSI();
      relay_SetStatus(PRIME_COMPR, ON);
      primComprOn = true;
      resetTimer();
      primeInit = true;
    }
    tank = getMainPressure();
    if (tank > 120) {
      relay_SetStatus(PRIME_COMPR, OFF);
      relay_SetStatus(MAINT_COMPR, OFF);
      maintComprOn = false;
      primComprOn = false;
      resetTimer(); //error counter?
      turnOffErrorLight();
      primeInit = false;
      current_state = NORM_IDLE_STATE;
    }
    if (getMinutesTimer() > 29) {
      primeInit = false;
      current_state = TIME_ERROR_STATE;
    }
  }
  else if (current_state == TIME_ERROR_STATE) {
    if (errorInit == false) {
      relay_SetStatus(PRIME_COMPR, OFF);
      relay_SetStatus(MAINT_COMPR, OFF);
      maintComprOn = false;
      primComprOn = false;
      turnOnErrorLight();
      resetTimer();
      errorInit = true;
    }
    lcd.print("WARNINGtime!WARNINGwarningTIME!warningWARNINGtime!WARNINGwarningTIME!warning"); // 80 char string will cover whole display
    delay(2000);
    if (checkButtonPress(ERROR_BUTTON)) { //overide button hit
      turnOffErrorLight();
      resetTimer();
      errorInit = false;
      current_state = NORM_IDLE_STATE;
    }
    
    if (getHoursTimer() > 11) {
      errorInit = false;
      current_state = NORM_IDLE_STATE;
    }
  }
  else if(current_state == OPEN_DRAIN_STATE) {
    resetTimer();
    relay_SetStatus(DRAIN_VALVE, OPEN);
    drainValveOpen = true;
      lcd.print(generateLCDString(current_state));
    delay(2000);
    relay_SetStatus(DRAIN_VALVE, CLOSED);
    drainValveOpen = false;
    current_state = NORM_IDLE_STATE;
  }
}
